/* Right half -- identical to corne_left.overlay.
 *
 * No RGB on this board -- no LEDs are installed.
 *
 * ZMK's own Corne shield tree (app/boards/shields/corne/boards/
 * nice_nano_nrf52840_zmk.overlay) declares &spi3 status = "okay" with a ws2812
 * led_strip on it, and that file is always applied. Disabling the bus here is
 * belt-and-braces: with CONFIG_ZMK_RGB_UNDERGLOW=n nothing selects LED_STRIP, so
 * CONFIG_SPI stays off and SPIM3 is never initialized anyway. This just makes it
 * impossible for a stray Kconfig to quietly turn the peripheral back on.
 *
 * Nothing else is needed: the nice!nano v2 board overlay already provides
 * vbatt + chosen { zmk,battery = &vbatt; }.
 *
 * To restore RGB: drop this file, and re-add the module per build.yaml.
 */

&spi3 {
    status = "disabled";
};
